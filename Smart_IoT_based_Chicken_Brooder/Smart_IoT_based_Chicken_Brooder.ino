#include "arduino_secrets.h"

#include "thingProperties.h" #include "DHT.h"
#include <Servo.h> Servo myservo;
// create servo object to control a servo
// twelve servo objects can be created on
//most boards int pos = 0;
#define DHTPIN D5 // D8 #define DHTTYPE DHT11 // DHT 11 #define relay_fan D4
#define LED_relay_PIN D2 #define relay_pump D3 #define servo_PIN D6
ï¬oat temp_threshold_up = 35.0; ï¬oat temp_threshold_low = 30.0; DHT dht(DHTPIN, DHTTYPE);
void setup() { Serial.begin(9600); dht.begin();
pinMode(LED_relay_PIN, OUTPUT); pinMode(relay_fan, OUTPUT); pinMode(relay_pump, OUTPUT); myservo.attach(servo_PIN);
//digitalWrite(relay_fan,LOW); delay(1500);
initProperties(); ArduinoCloud.begin(ArduinoIoTPreferredCo nnection);
setDebugMessageLevel(2); ArduinoCloud.printDebugInfo();
}
void loop()
{
ArduinoCloud.update(); // Your code here DHT_Sensor_Data();
}
void DHT_Sensor_Data() { ï¬oat h = dht.readHumidity(); ï¬oat t = dht.readTemperature(); temperature = t;
humidity = h; Serial.print("Humidity (%): "); Serial.println(h); Serial.print("Temperature (C): "); Serial.println(t);
delay(1000);
if (t>temp_threshold_up) { digitalWrite(relay_fan,LOW);
}
else if (t<temp_threshold_low) { digitalWrite(LED_relay_PIN,HIGH);
}
}
void onFanChange()
 
/* Sketch generated by the Arduino IoT Cloud Thing "Untitled" https://create.arduino.cc/cloud/things/2 372ccab-20da-40c3-98f7-ac189990cb8 f Arduino IoT Cloud Variables description The following variables are automatically
 

// Initialize serial and wait for port to open


// Defined in thingProperties.h

// Connect to Arduino IoT Cloud

/* The following function allows us to obtain more information related to the state of network and IoT Cloud connection and errors the higher number the more granular information youâll get. The default is 0 (only errors). Maximum is 4 */

/* Since LED is READ_WRITE variable, onLEDChange() is executed every time a new value is received from IoT Cloud. */


/* Since Fan is READ_WRITE variable, onFanChange() is executed every time a new value is received from IoT Cloud. */
 

Microcontroller and IOT based Chicken Brooder	EEE 416 (January 2022) C2 Group 6- Final Project
 
{
if (fan == 0) digitalWrite(relay_fan, HIGH); else if (fan == 1) digitalWrite(relay_fan, LOW);
}
void onPumpChange() { if (pump == 0)
{
digitalWrite(relay_pump, HIGH); feeder_on();
}
else if (pump == 1) { digitalWrite(relay_pump, LOW); myservo.write(-150);
} }
void onLedChange()
{
if (led == 1) digitalWrite(LED_relay_PIN, LOW); else
digitalWrite(LED_relay_PIN, HIGH);
}
void feeder_on()
{
for (pos = -120; pos <= 120; pos = pos + 10)
{
myservo.write(pos); delay(30);
}
delay(2000);
for (pos = 120; pos <= -120; pos = pos - 10)
{
myservo.write(pos);
